## arch/arm/mach-dove/Kconfig
```kconfig
if ARCH_DOVE

config  MV_HAL_RULES_PATH
        string "path of the mvRules.mk file for HAL drivers"
        default "arch/arm/mach-dove/mv_hal_support/mvRules.mk"
        ---help---
	
#source "arch/arm/plat-orion/mv_hal_drivers/Kconfig"

menu "Marvell Dove Implementations"
choice
	prompt "Dove SoC Silicon Revision"
	default DOVE_REV_Y0

config DOVE_REV_Y0
	bool "Dove Revision Y0"
	help
	  This enables support for Dove Y0 silicon

endchoice

config GLOBAL_PREEMPT_NOTIFIERS
	bool "Enable global preempt notifier"
	select PREEMPT_NOTIFIERS
	default y

config MACH_DOVE_RD_AVNG
	bool "Marvell RD-MV88F6781 Avengers Reference design platform"
	select I2C_BOARDINFO
	depends on DOVE_REV_Y0
	help
	  Say 'Y' here if you want your kernel to support the
	  Marvell RD-MV88F6781 Avengers Mobile Internet Device Reference design
	  platform.

config MACH_DOVE_RD_AVNG_V3
	bool "Marvell RD-88AP510 Avengers Reference design V3 platform"
	select I2C_BOARDINFO
	depends on DOVE_REV_Y0
	help
	  Say 'Y' here if you want your kernel to support the
	  Marvell RD-88AP510 Avengers Mobile Internet Device Reference design V3
	  platform 


config MV_INCLUDE_MPP_SYSFS
        bool "Avengers MPP sysfs Support"
        depends on MACH_DOVE_RD_AVNG_Z0 || MACH_DOVE_RD_AVNG
        default y
        ---help---
        Please don't change this configs unless you know what you are doing.

config MACH_DOVE_RD
	bool "Marvell RD-MV88F6781 Reference design platform"
	select I2C_BOARDINFO
	help
	  Say 'Y' here if you want your kernel to support the
	  Marvell RD-MV88F6781 Reference design platform.

config MACH_DOVE_DB
	bool "Marvell DB-MV88F6781 Development Board"
	select I2C_BOARDINFO
	depends on DOVE_REV_Y0
	help
	  Say 'Y' here if you want your kernel to support the

config MACH_DOVE_DB_B
	bool "Marvell DB-88AP510-BP-B Development Board"
	select I2C_BOARDINFO
	depends on DOVE_REV_Y0
	help
	  Say 'Y' here if you want your kernel to support the

config DOVE_DB_USE_GPIO_I2C
        bool "Use gpio-i2c driver for TWSI option 2 bus"
	select I2C_GPIO
	depends on MACH_DOVE_DB_B
	default n
	help
	  Say 'Y' here is you want to use the gpio-i2c driver to control
	  TWSI option2 wires. This is usefull when this bus used for VGA
	  port and DDC1 screen is connected.

config MACH_DOVE_VIDEOPLUG
       bool "Marvell 88AP510 Video Plug Board"
       select I2C_BOARDINFO
       depends on DOVE_REV_Y0
       help
	  Say 'Y' here if you want your kernel to support the
	  Marvell  88AP510 Video Plug Board.

endmenu

config MV_HAL_DRIVERS_SUPPORT
	bool "Enable HAL based drivers support"
	depends on ARCH_DOVE
	select MV_INCLUDE_INTEG_SATA
	help
	  Say 'Y' here if you want your kernel to support HAL 
	  based drivers where possible.

config DOVE_PM_SUPPORT
	depends on PM && MV_INCLUDE_PMU && MV_HAL_DRIVERS_SUPPORT
	def_bool y

config MV_EXT_VGA_CLOCK
       tristate "Marvell external IDT5V49EE503 clock on 88AP510 Board"
       help
	  Say 'Y' here if you want your kernel to support the
	  external video clock on Marvell  88AP510 Board.
	  This clock enables dual-head VGA out with different resolution

endif
```

## arch/arm/mach-integrator/Kconfig
```kconfig
if ARCH_INTEGRATOR

menu "Marvell Tahoe Options"

choice
	depends on ARCH_INTEGRATOR_AP
	prompt "Tahoe_AHB/Tahoe_AXI/DoveNB"
	default ARCH_TAHOE_AXI

config ARCH_TAHOE_AXI
	bool "Support Tahoe AXI platform"
	default n
	help
	  Include support for Marvell Tahoe AXI Platform

config ARCH_TAHOE_AHB
	bool "Support Tahoe AHB platform"
	default n
	help
	  Include support for Marvell Tahoe AHB Platform

config ARCH_DOVENB_ON_TAHOE_AXI
	bool "Support Dove NB Testchip on Tahoe AXI platform"
	default n
	help
	  Include support for Marvell Tahoe AHB Platform
endchoice

endmenu

menu "Integrator Options"

config ARCH_INTEGRATOR_AP
	bool "Support Integrator/AP and Integrator/PP2 platforms"
	help
	  Include support for the ARM(R) Integrator/AP and
	  Integrator/PP2 platforms.

config ARCH_INTEGRATOR_CP
	bool "Support Integrator/CP platform"
	select ARCH_CINTEGRATOR
	help
	  Include support for the ARM(R) Integrator CP platform.

config ARCH_CINTEGRATOR
	bool

config INTEGRATOR_IMPD1
	tristate "Include support for Integrator/IM-PD1"
	depends on ARCH_INTEGRATOR_AP
	help
	  The IM-PD1 is an add-on logic module for the Integrator which
	  allows ARM(R) Ltd PrimeCells to be developed and evaluated.
	  The IM-PD1 can be found on the Integrator/PP2 platform.

	  To compile this driver as a module, choose M here: the
	  module will be called impd1.

endmenu

endif
```

## arch/arm/plat-orion/mv_hal_drivers/Kconfig
```kconfig
if PLAT_ORION

menu "Orion SoC options"
depends on MV_HAL_DRIVERS_SUPPORT
#since the Kconfig parser dispatch all source commands, we call the machines Kconfigs from here and
#not vice versa because otherwise the plat-feroceon Kconfig will be dispatched twice.     

config MV_INCLUDE_IDMA
	bool "IDMA Support"
	default y
        ---help---
        Please don't change this configs unless you know what you are doing.

config MV_INCLUDE_USB
	bool "USB Support"
	default y
        ---help---
        Please don't change this configs unless you know what you are doing.

config MV_INCLUDE_XOR
	bool "XOR Support"
	default y
        ---help---
        Please don't change this configs unless you know what you are doing.

config MV_INCLUDE_CESA
	bool "CESA Support"
	default y
        ---help---
        Please don't change this configs unless you know what you are doing.

config MV_INCLUDE_GIG_ETH
	bool "Giga Ethernet Support"
	default y

config MV_INCLUDE_AUDIO
	bool "Audio Support"
	default y
        ---help---
        Please don't change this configs unless you know what you are doing.

config MV_INCLUDE_INTEG_SATA
        bool "Integrated SATA Support"
        default y
        ---help---
        Please don't change this configs unless you know what you are doing.

config MV_INCLUDE_PMU
	bool "PM Support"
	depends on ARCH_DOVE
	default y
	---help---
	Include the support of the Power Management Features.
	Please don't change this configs unless you know what you are doing.

config MV_INCLUDE_NFC
	bool "Integrated Nand Flash Support"
	depends on ARCH_DOVE
	default y
	---help---
	Please don't change this configs unless you know what you are doing.


config MV_DDRMMC
	bool
	depends on ARCH_DOVE
	default y


endmenu

menu "Soc DMA accelerations"

source arch/arm/plat-orion/mv_hal_drivers/mv_drivers_lsp/mv_xor/Kconfig

#source arch/arm/plat-orion/mv_hal_drivers/mv_drivers_lsp/mv_dma/Kconfig

endmenu

menu "SoC Networking support"
depends on MV_INCLUDE_GIG_ETH

source arch/arm/plat-orion/mv_hal_drivers/mv_drivers_lsp/mv_network/Kconfig

endmenu


source arch/arm/plat-orion/mv_hal_drivers/mv_drivers_lsp/mv_cesa/Kconfig

config  SCSI_MVSATA
        tristate "Support for Marvell Sata Adapters"
	depends on MV_HAL_DRIVERS_SUPPORT
        depends on ( MV_INCLUDE_INTEG_SATA && SCSI ) || ( PCI && SCSI )
        ---help---
          Choosing this option will enable you to use the Marvell Sata
          adapters support with emulation as SCSI adapters.
          Note that the kernel scsi subsystem must be chosen too.

source arch/arm/plat-orion/mv_hal_drivers/mv_drivers_lsp/mv_sata/Kconfig

# Definitions to make life easier
config MV_FAST_PATH_ETHERNET
        bool
endif

source arch/arm/plat-orion/mv_hal_drivers/mv_drivers_lsp/mv_key/Kconfig

config  MV_DBG_TRACE
        bool "Enable tracing utility"
        default n
        ---help---
          Choosing this debug option will cause some kernel modules to log operations into
          a cyclic buffer and dump them on failures. Enabling this feature decreases performance.
```

## arch/arm/plat-orion/mv_hal_drivers/mv_drivers_lsp/mv_key/Kconfig
```kconfig
menu "Marvell Key driver"

config MV_GPIO_KEY
	tristate "Marvell GPIO Key driver"
	---help---
	  This selects the Marvell GPIO Key driver
	  say Y or M here.
	  If unsure, say N.

config MV_TOUCH_KEY
	tristate "Marvell Touch Key driver"
	---help---
	  This selects the Marvell Touch Key driver
	  say Y or M here.
	  If unsure, say N.

config MV_TOUCH_SLIDER
	tristate "Marvell Touch Slider driver"
	---help---
	  This selects the Marvell Touch Slider driver
	  say Y or M here.
	  If unsure, say N.

config MV_EC_KEY
	tristate "Marvell EC Key driver"
	---help---
	  This selects the Marvell EC Key driver
	  say Y or M here.
	  If unsure, say N.

endmenu
```

## drivers/i2c/chips/Kconfig
```kconfig
#
# Miscellaneous I2C chip drivers configuration
#
# *** DEPRECATED! Do not add new entries! See Makefile ***
#

menu "Miscellaneous I2C Chip support"

config DS1682
	tristate "Dallas DS1682 Total Elapsed Time Recorder with Alarm"
	depends on EXPERIMENTAL
	help
	  If you say yes here you get support for Dallas Semiconductor
	  DS1682 Total Elapsed Time Recorder.

	  This driver can also be built as a module.  If so, the module
	  will be called ds1682.

config SENSORS_TSL2550
	tristate "Taos TSL2550 ambient light sensor"
	depends on EXPERIMENTAL
	help
	  If you say yes here you get support for the Taos TSL2550
	  ambient light sensor.

	  This driver can also be built as a module.  If so, the module
	  will be called tsl2550.

config MENELAUS
	bool "TWL92330/Menelaus PM chip"
	depends on I2C=y && ARCH_OMAP24XX
	help
	  If you say yes here you get support for the Texas Instruments
	  TWL92330/Menelaus Power Management chip. This include voltage
	  regulators, Dual slot memory card tranceivers, real-time clock
	  and other features that are often used in portable devices like
	  cell phones and PDAs.

config MAX1535
	tristate "MAX 1535 SMBus Battery Charger chip"
	default y if MACH_DOVE_RD
	help
	  If you say yes here you get support for MAX 1535 SMBus Battery
	  Charger.

endmenu
```

## drivers/misc/mrvl-bmm/Kconfig
```kconfig
config DOVE_MRVL_BMM
	tristate "Marvell Buffer management module"
	default y
	help
	  This driver needs to co-work with user space BMM library.
	  The user space driver can use this driver/library to maintain it's own buffer.

config DOVE_VPU_USE_BMM
	bool "Dove VPU use BMM"
	depends on DOVE_MRVL_BMM
	default y
	help
	  Dove VPU use BMM to maintian buffer.

config DOVE_GPU_USE_BMM
	bool "Dove GPU use BMM"
	depends on DOVE_MRVL_BMM && DOVE_VPU_USE_BMM
	default n
	help
	  Dove GPU use BMM to maintian buffer.
```

## drivers/scsi/mvumi/Kconfig
```kconfig
config MVUMI_SAS
        tristate "Marvell SAS RAID Module"
        depends on PCI && SCSI
        help
        Module for Marvell RAID based on SAS controllers.
        To compile this driver as a module, choose 'm' here.
        Module will be called mvraid_sas
```

## drivers/video/display/Kconfig
```kconfig
#
# Display drivers configuration
#

menu "Display device support"

config DISPLAY_SUPPORT
	tristate "Display panel/monitor support"
	---help---
	  This framework adds support for low-level control of a display.
	  This includes support for power.

	  Enable this to be able to choose the drivers for controlling the
	  physical display panel/monitor on some platforms. This not only
	  covers LCD displays for PDAs but also other types of displays
	  such as CRT, TVout etc.

	  To have support for your specific display panel you will have to
	  select the proper drivers which depend on this option.

comment "Display hardware drivers"
	depends on DISPLAY_SUPPORT

config CH7025_COMPOSITE
    tristate "TV-OUT support (Chrontel CH7025/CH7026 TV Composite)"
    default y
    help
       The device is able to encode the video signals and generate
       synchronization signals SDTV format for NTSC and PAL standards.

config KG2_ANX7150
	tristate "KG2_ANX7150 support"
	default y
	help
	  KG2/ANX7150 device driver support.

config ADI9889
	tristate "ADI9889 support"
	default n
	help
	  ADI9889 device driver support.

config THS8200
       tristate "THS8200 support"

       default y
       help
         THS8200 device driver support.
endmenu
```
