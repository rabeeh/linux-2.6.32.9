## drivers/video/marvell/Kconfig
```kconfig
config FB_DOVE
	bool "Marvell LCD controller"
	depends on FB && ARCH_DOVE
	help
	  Support for Marvell Dove SoC LCD controller.

config FB_DOVE_CONSISTENT_DMA_SIZE
	int "Consistent DMA memory size (MB)"
	depends on FB_DOVE && (FB_DOVE_CLCD || FB_DOVE_CLCD1)
	range 2 46
	default 46
	help
	  Increase the DMA consistent memory size according to your video
	  memory needs.
	  The size must be 2MB aligned.

config FB_DOVE_CLCD
	tristate "Marvell DOVE Color LCD support"
	depends on FB && ARM && FB_DOVE
	select FB_CFB_FILLRECT
	select FB_CFB_COPYAREA
	select FB_CFB_IMAGEBLIT
	---help---
	Marvell DOVE Color LCD. If not sure, say N. If want to config 
	resolution, please use bootargs, e.g. dovefb:640x480-16@60.

menu "LCD0 I2C setting"
	depends on FB_DOVE && FB_DOVE_CLCD

config FB_DOVE_CLCD0_I2C_DEFAULT_SETTING
	bool "Use LCD0 I2C default setting"
	default y
	---help---
	LCD0 I2C default setting: use I2C channel 1 and I2C address 0x3F
	to get EDID data.

config FB_DOVE_CLCD0_I2C_CHANNEL
	int "Set I2C Channel"
	depends on !FB_DOVE_CLCD0_I2C_DEFAULT_SETTING
	range 0 2
	default 1
	---help---
	You can set I2C channel number between 0~2.

config FB_DOVE_CLCD0_I2C_ADDRESS
	hex "Set I2C Address"
	depends on !FB_DOVE_CLCD0_I2C_DEFAULT_SETTING
	range 0x0 0x7f
	default 0x3f
	---help---
	You can set I2C address number between 0~0x7f

endmenu

config FB_DOVE_CLCD1
	tristate "Marvell DOVE Secondary Color LCD support"
	depends on FB && ARM && FB_DOVE
	select FB_CFB_FILLRECT
	select FB_CFB_COPYAREA
	select FB_CFB_IMAGEBLIT
	select FB_DOVE_DCON
	---help---
	Say Y here if your Secondary LCD panel is VGA. Default is N.

menu "LCD1 I2C setting"
	depends on FB_DOVE && FB_DOVE_CLCD1

config FB_DOVE_CLCD1_I2C_DEFAULT_SETTING
	bool "Use LCD1 I2C default setting"
	default y
	---help---
	LCD1 I2C default setting: use I2C channel 1 and I2C address 0x50
	to get EDID data.

config FB_DOVE_CLCD1_I2C_CHANNEL
	int "Set I2C Channel"
	depends on !FB_DOVE_CLCD1_I2C_DEFAULT_SETTING
	range 0 2
	default 1
	---help---
	You can set I2C channel number between 0~2.

config FB_DOVE_CLCD1_I2C_ADDRESS
	hex "Set I2C Address"
	depends on !FB_DOVE_CLCD1_I2C_DEFAULT_SETTING
	range 0x0 0x7f
	default 0x50
	---help---
	You can set I2C address number between 0~0x7f

endmenu

config FB_DOVE_CLCD_EDID
	bool "Marvell DOVE read EDID utility"
	depends on FB_DOVE
	select I2C
	select I2C_MV64XXX
	select FB_DDC
	select FB_MODE_HELPERS
	---help---
	Enable reading the EDID information of the screen. Default is N.

config FB_DOVE_DCON
	tristate "Marvell DOVE DCON support"
	depends on ARM && FB_DOVE
	---help---
	Say Y here if want to enable DCON. (HW default bypass.)

choice
	depends on FB_DOVE && FB_DOVE_DCON
	prompt "DOVE DCON Panel PortA" 
	default FB_DOVE_CLCD_DCONA_BYPASS

config FB_DOVE_CLCD_DCONA_BYPASS
	bool "LCD0 Bypass"
	help
	  Marvell DOVE DCON LCD0 Bypass mode. Default is Y.

config FB_DOVE_CLCD_DCONA_OLPC
	bool "OLPC DCON Mode(Not support now)"
	help
	  Say Y here if your DCON is OLPC mode. Default is N.

config FB_DOVE_CLCD_DCONA_DUALVIEW
	bool "LCD0/1 dual view Mode(Not support now)"
	help
	  Say Y here if you have two LCD panel. Default is N.

config FB_DOVE_CLCD_DCONA_MODE
	bool "DCON Mode, LCD0 data (Not support now)"
	help
	  Say Y here if your DCON is DCON mode. Default is N.

endchoice

choice
	depends on FB_DOVE && FB_DOVE_DCON
	prompt "DOVE DCON Panel PortB"
	default FB_DOVE_CLCD_DCONB_BYPASS1

config FB_DOVE_CLCD_DCONB_BYPASS1
	bool "LCD1 Bypass"
	help
	  Marvell DOVE DCON LCD1 Bypass mode. Default is Y.

config FB_DOVE_CLCD_DCONB_BYPASS0
	bool "LCD0 Bypass"
	help
	  Say Y here if your DCON is bypass LCD0. Default is N.

endchoice

menu "PLL clock speed when under inaccurate mode"
	depends on FB_DOVE && (FB_DOVE_CLCD || FB_DOVE_CLCD1)

config FB_DOVE_CLCD_SCLK_VALUE
	int "PLL clock speed"
	default "1000"
	depends on (FB_DOVE_CLCD || FB_DOVE_CLCD1)
	---help---
	This paramter (in MHz) determines the source clock rate.
	The default is 1000MHz(PLL). This value only is applied
	when system is under inaccurate mode and two lcds use
	PLL as refclk at the same time. The real frquency depends
	on HW setting. Change this if you know how to set it.

endmenu

config FB_DOVE_CLCD_DEFAULT_OPTION
	string "Default Dove FB kernel parameter"
	depends on FB_DOVE && (FB_DOVE_CLCD || FB_DOVE_CLCD1)
	default "lcd0:1280x768-24@60,lcd1:1024x768-16@60"

config DOVEFB_DISPLAY_MODE
	tristate "Support display configuration."
	depends on FB_DOVE && FB_DOVE_CLCD && FB_DOVE_CLCD1
	default n if ARCH_DOVE
	---help---
	Say Y here if you want to build driver into kernel. Default is N.

config FB_DOVE_CLCD_FLAREON_GV
	tristate "Marvell DOVE Color LCD - Flareon GV"
	depends on FB_DOVE && (FB_DOVE_CLCD || FB_DOVE_CLCD1)
	default y if ARCH_REALVIEW
	---help---
	Say Y here if your LCD version is on Flareon GV. Default is N.

## Following is for MUSTANG LCD config
config FB_MUSTANG_CLCD
    tristate "Marvell Mustang Color LCD support"
    default n
    depends on FB_DOVE
    select FB_CFB_FILLRECT
    select FB_CFB_COPYAREA
    select FB_CFB_IMAGEBLIT
    ---help---
    Marvell Mustang Color LCD. If not sure, say N.

config FB_MUSTANG_QVGA
    bool "Marvell Mustang Color LCD - QVGA"
    default n
    depends on FB_MUSTANG_CLCD
    ---help---
       Say Y here if your LCD panel is QVGA. Default is N.
config FB_MUSTANG_LOW_REFLESH_RATE
	bool "Lower Reflesh Rate of LCD DMA"
	default n
	depends on FB_MUSTANG_CLCD
	help
	  Say Y if you are using Tahoe FPGA System
	  It will slow down to 1/2 original LCD  refresh rate
## End of MUSTANG LCD config
```

## sound/soc/orion/Kconfig
```kconfig
menu "SoC Audio for the Marvell SoC's"

config SND_DOVE_AC97
	tristate "Marvell Dove AC97 interface support"
	depends on ARCH_DOVE && SND_SOC
	select SND_AC97_CODEC
	select AC97_BUS
	help
	  Say Y or M if you want to add support for the AC97 interface in Marvell
	  SoC's.

config SND_DOVE_SOC_DB
	tristate "SoC AC97 Audio support for Marvell Dove DB"
	depends on SND_DOVE_AC97 && (MACH_DOVE_DB || MACH_DOVE_DB_Z0)
	select SND_PXA2XX_SOC
	select SND_PXA2XX_LIB
	select SND_PXA2XX_SOC_AC97
	select SND_PXA2XX_SOC_AC97_SURROUND
	select SND_SOC_AD1980
	help
	  Say Y if you want to add support for SoC audio on Marvell
	  Dove Development Board.

config SND_DOVE_SOC_DB_B
	tristate "SoC AC97 Audio support for Marvell Dove DB-B"
	depends on SND_DOVE_AC97 && MACH_DOVE_DB_B
	select SND_PXA2XX_SOC
	select SND_PXA2XX_LIB
	select SND_PXA2XX_SOC_AC97
	select SND_PXA2XX_SOC_AC97_SURROUND
	select SND_SOC_AC97_CODEC
	help
	  Say Y if you want to add support for SoC audio on Marvell
	  Dove Development Board.


config SND_DOVE_SOC_AC97_AVD1
        tristate "SoC AC97 Audio support for AVD1"
        depends on SND_DOVE_AC97
        select SND_PXA2XX_SOC
	select SND_PXA2XX_LIB
        select SND_PXA2XX_SOC_AC97
        select SND_PXA2XX_SOC_AC97_SURROUND
        select SND_SOC_RT5610


config SND_DOVE_SOC_MRVL_AUDIO
	tristate "Marvell mv88fx Audio ALSA SOC driver"
	depends on MV_INCLUDE_AUDIO && SND_SOC
	help
	  Say Y if you want to add support for SoC audio on Marvell
	  Dove Development Board.

menu "Select Codecs for the mv88fx i2s"
     depends on SND_DOVE_SOC_MRVL_AUDIO

config CODEC_CS42L51
        bool "CS42L51 codec"
        depends on SND_DOVE_SOC_MRVL_AUDIO
        select SND_SOC_CS42L51

config CODEC_RT5623
        bool "RT5623 codec"
        depends on SND_DOVE_SOC_MRVL_AUDIO
        select SND_SOC_RT5623

config CODEC_RT5630
        bool "RT5630 codec"
        depends on SND_DOVE_SOC_MRVL_AUDIO
        select SND_SOC_RT5630

endmenu
endmenu
```
